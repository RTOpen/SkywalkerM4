## software/remoter/Receiver/board/Kconfig
```kconfig
menu "Hardware Drivers Config"

config SOC_CH58X
    bool
    select SOC_RISCV_SERIES_CH58X
    select RT_USING_COMPONENTS_INIT
    select RT_USING_USER_MAIN
    default y

menu "On-chip Peripheral Drivers"
    config BSP_USING_GPIO
        bool "Enable GPIO"
        select RT_USING_PIN
        default y

    menuconfig BSP_USING_UART
        bool "Enable UART"
        select RT_USING_SERIAL
        default n

        if BSP_USING_UART
            config BSP_USING_UART1
                bool "Enable UART1"
                default n

            config BSP_USING_UART2
                bool "Enable UART2"
                default n

            config BSP_USING_UART3
                bool "Enable UART3"
                default n
        endif

    menuconfig BSP_USING_ADC
        bool "Enable ADC"
        default n

    menuconfig BSP_USING_SOFT_I2C
        bool "Enable I2C Bus"
        select RT_USING_I2C
        select RT_USING_I2C_BITOPS
        select RT_USING_PIN
        default n

        if BSP_USING_SOFT_I2C
            config BSP_USING_I2C1
                bool "Enable I2C1 Bus (software simulation)"
                default n

                if BSP_USING_I2C1
                    comment "Notice: PB10 --> 26; PB11 --> 27"

                    config BSP_I2C1_SCL_PIN
                        int "i2c1 SCL pin number"
                        range 0 79
                        default 26
                    config BSP_I2C1_SDA_PIN
                        int "i2c1 SDA pin number"
                        range 0 79
                        default 27
                endif
        endif

    menuconfig BSP_USING_SPI
        bool "Enable SPI"

        if BSP_USING_SPI
            config BSP_USING_SPI1
                bool "Enable SPI1"
                default n

            config BSP_USING_SPI2
                bool "Enable SPI2"
                default n

        endif

    config BSP_USING_RTC
        bool "Enable RTC"
        select RT_USING_RTC
        default n

        if BSP_USING_RTC
            config BSP_USING_RTC_LSI
                bool "Using LSI clock for rtc, if not, LSE default"
                select LSI_VALUE
                default n
        endif

    config LSI_VALUE
        int
        default 40000

    config BSP_USING_WDT
        bool "Enable WDT"
        select RT_USING_WDT
        select LSI_VALUE
        default n

endmenu

menu "Board extended module Drivers"

endmenu

endmenu
```
